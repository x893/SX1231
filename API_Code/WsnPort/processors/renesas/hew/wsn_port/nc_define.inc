;------------------------------------------------------------------------
;                                                                       |
;   FILE        :nc_define.inc                                          |
;   DATE        :Thu, Dec 11, 2008                                      |
;   DESCRIPTION :interrupt program.                                     |
;   CPU GROUP   :1B                                                     |
;                                                                       |
;   This file is generated by Renesas Project Generator (Ver.4.13).     |
;                                                                       |
;------------------------------------------------------------------------
; Macro Symbol definition
__STANDARD_IO__    .equ	0	; STANDARD I/O flag definition
__HEAPSIZE__       .equ	000H	; HEEP SIZE definition
__STACKSIZE__      .equ	0a0H	; STACK SIZE definition
__ISTACKSIZE__     .equ	020H	; INTERRUPT STACK SIZE definition
__VECTOR_ADR__     .equ	0fedcH	; INTERRUPT VECTOR ADDRESS definition
__ROM_TOPADR__     .equ	0C800H	; ROM TOP ADDRESS definition
